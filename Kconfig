## Kconfig
```kconfig
config SSF_SENSOR
	tristate "SSF Modbus sensor driver"
	depends on SERIAL_DEV_BUS && IIO
	select CRC16
	select IIO_BUFFER
	select IIO_KFIFO_BUF
	help
	  Build the SSF sensor driver for a Modbus RTU device connected through
	  the Linux serial-device (serdev) bus and expose its measurements through
	  the Industrial I/O subsystem.

	  Select M to build a loadable module named ssf_mems.ko, or Y to link
	  it into the kernel.
```
